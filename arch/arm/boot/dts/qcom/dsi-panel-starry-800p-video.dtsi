/* Novatek Android Driver Sample Code for Novatek chipset
*
* Copyright (C) 2018 Novatek Microelectronics Corp.
*
* This software is licensed under the terms of the GNU General Public
* License version 2, as published by the Free Software Foundation, and
* may be copied, distributed, and modified under those terms.
*
* This program is distributed in the hope that it will be useful,
* but WITHOUT ANY WARRANTY; without even the implied warranty of
* MERCHANTABILITY or FITNESS FOR A PARTICULAR PURPOSE.  See the
* GNU General Public License for more details.
*
*/

&mdss_mdp {
        dsi_starry_800p_video: qcom,mdss_dsi_starry_800p_video {
		qcom,mdss-dsi-panel-name = "JD9365 Starry 800P MDSS DSI";
		qcom,mdss-dsi-panel-controller = <&mdss_dsi0>;
		qcom,mdss-dsi-panel-type = "dsi_video_mode";
		qcom,mdss-dsi-panel-framerate = <60>;
		qcom,mdss-dsi-virtual-channel-id = <0>;
		qcom,mdss-dsi-stream = <0>;
		qcom,mdss-dsi-panel-width = <800>;
		qcom,mdss-dsi-panel-height = <1280>;
		qcom,mdss-dsi-h-front-porch = <18>;
		qcom,mdss-dsi-h-back-porch = <18>;
		qcom,mdss-dsi-h-pulse-width = <18>;
		qcom,mdss-dsi-h-sync-skew = <0>;
		qcom,mdss-dsi-v-back-porch = <4>;
		qcom,mdss-dsi-v-front-porch = <16>;
		qcom,mdss-dsi-v-pulse-width = <4>;
		qcom,mdss-dsi-h-left-border = <0>;
		qcom,mdss-dsi-h-right-border = <0>;
		qcom,mdss-dsi-v-top-border = <0>;
		qcom,mdss-dsi-v-bottom-border = <0>;
		qcom,mdss-dsi-bpp = <24>;
		qcom,mdss-dsi-underflow-color = <0xff>;
		qcom,mdss-dsi-border-color = <0>;
		qcom,mdss-dsi-on-command = [
			15 01 00 00 00 00 02 E0 00
			15 01 00 00 00 00 02 E1 93
			15 01 00 00 00 00 02 E2 65
			15 01 00 00 00 00 02 E3 F8
			15 01 00 00 00 00 02 80 03
			15 01 00 00 00 00 02 E0 01
			15 01 00 00 00 00 02 17 00
			15 01 00 00 00 00 02 18 AF
			15 01 00 00 00 00 02 19 01
			15 01 00 00 00 00 02 1A 00
			15 01 00 00 00 00 02 1B AF
			15 01 00 00 00 00 02 1C 01
			15 01 00 00 00 00 02 1F 3E
			15 01 00 00 00 00 02 20 28
			15 01 00 00 00 00 02 21 28
			15 01 00 00 00 00 02 22 7E
			15 01 00 00 00 00 02 35 26
			15 01 00 00 00 00 02 37 09
			15 01 00 00 00 00 02 38 04
			15 01 00 00 00 00 02 39 00
			15 01 00 00 00 00 02 3A 01
			15 01 00 00 00 00 02 3C 7C
			15 01 00 00 00 00 02 3D FF
			15 01 00 00 00 00 02 3E FF
			15 01 00 00 00 00 02 3F 7F
			15 01 00 00 00 00 02 40 06
			15 01 00 00 00 00 02 41 A0
			15 01 00 00 00 00 02 42 81
			15 01 00 00 00 00 02 43 08
			15 01 00 00 00 00 02 44 0B
			15 01 00 00 00 00 02 45 28
			15 01 00 00 00 00 02 55 0F
			15 01 00 00 00 00 02 57 69
			15 01 00 00 00 00 02 59 0A
			15 01 00 00 00 00 02 5A 28
			15 01 00 00 00 00 02 5B 14
			15 01 00 00 00 00 02 5D 7C
			15 01 00 00 00 00 02 5E 65
			15 01 00 00 00 00 02 5F 55
			15 01 00 00 00 00 02 60 47
			15 01 00 00 00 00 02 61 43
			15 01 00 00 00 00 02 62 32
			15 01 00 00 00 00 02 63 34
			15 01 00 00 00 00 02 64 1C
			15 01 00 00 00 00 02 65 33
			15 01 00 00 00 00 02 66 31
			15 01 00 00 00 00 02 67 30
			15 01 00 00 00 00 02 68 4E
			15 01 00 00 00 00 02 69 3C
			15 01 00 00 00 00 02 6A 44
			15 01 00 00 00 00 02 6B 35
			15 01 00 00 00 00 02 6C 31
			15 01 00 00 00 00 02 6D 23
			15 01 00 00 00 00 02 6E 11
			15 01 00 00 00 00 02 6F 00
			15 01 00 00 00 00 02 70 7C
			15 01 00 00 00 00 02 71 65
			15 01 00 00 00 00 02 72 55
			15 01 00 00 00 00 02 73 47
			15 01 00 00 00 00 02 74 43
			15 01 00 00 00 00 02 75 32
			15 01 00 00 00 00 02 76 34
			15 01 00 00 00 00 02 77 1C
			15 01 00 00 00 00 02 78 33
			15 01 00 00 00 00 02 79 31
			15 01 00 00 00 00 02 7A 30
			15 01 00 00 00 00 02 7B 4E
			15 01 00 00 00 00 02 7C 3C
			15 01 00 00 00 00 02 7D 44
			15 01 00 00 00 00 02 7E 35
			15 01 00 00 00 00 02 7F 31
			15 01 00 00 00 00 02 80 23
			15 01 00 00 00 00 02 81 11
			15 01 00 00 00 00 02 82 00
			15 01 00 00 00 00 02 E0 02
			15 01 00 00 00 00 02 00 1E
			15 01 00 00 00 00 02 01 1E
			15 01 00 00 00 00 02 02 41
			15 01 00 00 00 00 02 03 41
			15 01 00 00 00 00 02 04 43
			15 01 00 00 00 00 02 05 43
			15 01 00 00 00 00 02 06 1F
			15 01 00 00 00 00 02 07 1F
			15 01 00 00 00 00 02 08 35
			15 01 00 00 00 00 02 09 1F
			15 01 00 00 00 00 02 0A 15
			15 01 00 00 00 00 02 0B 15
			15 01 00 00 00 00 02 0C 1F
			15 01 00 00 00 00 02 0D 47
			15 01 00 00 00 00 02 0E 47
			15 01 00 00 00 00 02 0F 45
			15 01 00 00 00 00 02 10 45
			15 01 00 00 00 00 02 11 4B
			15 01 00 00 00 00 02 12 4B
			15 01 00 00 00 00 02 13 49
			15 01 00 00 00 00 02 14 49
			15 01 00 00 00 00 02 15 1F
			15 01 00 00 00 00 02 16 1E
			15 01 00 00 00 00 02 17 1E
			15 01 00 00 00 00 02 18 40
			15 01 00 00 00 00 02 19 40
			15 01 00 00 00 00 02 1A 42
			15 01 00 00 00 00 02 1B 42
			15 01 00 00 00 00 02 1C 1F
			15 01 00 00 00 00 02 1D 1F
			15 01 00 00 00 00 02 1E 35
			15 01 00 00 00 00 02 1F 1F
			15 01 00 00 00 00 02 20 15
			15 01 00 00 00 00 02 21 15
			15 01 00 00 00 00 02 22 1f
			15 01 00 00 00 00 02 23 46
			15 01 00 00 00 00 02 24 46
			15 01 00 00 00 00 02 25 44
			15 01 00 00 00 00 02 26 44
			15 01 00 00 00 00 02 27 4A
			15 01 00 00 00 00 02 28 4A
			15 01 00 00 00 00 02 29 48
			15 01 00 00 00 00 02 2A 48
			15 01 00 00 00 00 02 2B 1F
			15 01 00 00 00 00 02 58 40
			15 01 00 00 00 00 02 5B 30
			15 01 00 00 00 00 02 5C 03
			15 01 00 00 00 00 02 5D 30
			15 01 00 00 00 00 02 5E 01
			15 01 00 00 00 00 02 5F 02
			15 01 00 00 00 00 02 63 14
			15 01 00 00 00 00 02 64 6A
			15 01 00 00 00 00 02 67 73
			15 01 00 00 00 00 02 68 05
			15 01 00 00 00 00 02 69 14
			15 01 00 00 00 00 02 6A 6A
			15 01 00 00 00 00 02 6B 08
			15 01 00 00 00 00 02 6C 00
			15 01 00 00 00 00 02 6D 00
			15 01 00 00 00 00 02 6E 00
			15 01 00 00 00 00 02 6F 88
			15 01 00 00 00 00 02 77 DD
			15 01 00 00 00 00 02 79 0E
			15 01 00 00 00 00 02 7A 03
			15 01 00 00 00 00 02 7D 14
			15 01 00 00 00 00 02 7E 6A
			15 01 00 00 00 00 02 E0 04
			15 01 00 00 00 00 02 09 11
			15 01 00 00 00 00 02 0E 48
			15 01 00 00 00 00 02 2B 2B
			15 01 00 00 00 00 02 2D 03
			15 01 00 00 00 00 02 2E 44
			15 01 00 00 00 00 02 E0 00
			15 01 00 00 00 00 02 E6 02
			15 01 00 00 00 00 02 E7 0C
			05 01 00 00 78 00 01 11
			05 01 00 00 05 00 01 29
			15 01 00 00 00 00 02 35 00
		];
		qcom,mdss-dsi-off-command = [
			39 01 00 00 14 00 02 28 00
			39 01 00 00 78 00 02 10 00
		];
		qcom,mdss-dsi-on-command-state = "dsi_lp_mode";
		qcom,mdss-dsi-off-command-state = "dsi_lp_mode";
		qcom,cont-splash-enabled;
		qcom,mdss-dsi-h-sync-pulse = <1>;
		qcom,mdss-dsi-traffic-mode = "burst_mode";
		qcom,mdss-dsi-lane-map = "lane_map_0123";
		qcom,mdss-dsi-bllp-eof-power-mode;
		qcom,mdss-dsi-bllp-power-mode;
		qcom,mdss-dsi-lane-0-state;
		qcom,mdss-dsi-lane-1-state;
		qcom,mdss-dsi-lane-2-state;
		qcom,mdss-dsi-lane-3-state;
		qcom,mdss-dsi-panel-timings = [f2 3a 28 00 6c 70 2c 3e 2e 03 04 00];
		qcom,mdss-dsi-t-clk-post = <0x0e>;
		qcom,mdss-dsi-t-clk-pre = <0x33>;
		qcom,mdss-dsi-bl-min-level = <1>;
		qcom,mdss-dsi-bl-max-level = <4095>;
		qcom,panel-supply-entries = <&dsi_panel_pwr_supply>;
		qcom,mdss-dsi-dma-trigger = "trigger_sw";
		qcom,mdss-dsi-mdp-trigger = "none";
		qcom,mdss-dsi-force-clock-lane-hs;
		//qcom,platform-bklight-en-gpio = <&tlmm 46 0>;
		//qcom,mdss-dsi-lcden-ctrl = <&tlmm 61 0>;
		qcom,mdss-dsi-bl-pmic-control-type = "bl_ctrl_wled";
		//qcom,mdss-dsi-bl-pmic-pwm-frequency = <100>;
		//qcom,mdss-dsi-bl-pmic-bank-select = <0>;
		//qcom,mdss-dsi-pwm-gpio = <&pm8953_mpps 4 0>;
		qcom,mdss-pan-physical-width-dimension = <135>;
		qcom,mdss-pan-physical-height-dimension = <216>;
		//qcom,mdss-dsi-reset-sequence = <1 10>, <0 5>, <1 50>;
		qcom,mdss-dsi-lp11-init;
		qcom,mdss-dsi-post-init-delay = <1>;
	};
};
